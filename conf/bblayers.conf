## conf/bblayers.conf
```bitbake
# POKY_BBLAYERS_CONF_VERSION is increased each time build/conf/bblayers.conf
# changes incompatibly
POKY_BBLAYERS_CONF_VERSION = "2"

BBPATH = "${TOPDIR}"
BBFILES ?= ""

BBLAYERS ?= " \
  /home/jordanimejia/yocto/poky/meta \
  /home/jordanimejia/yocto/poky/meta-poky \
  /home/jordanimejia/yocto/poky/meta-yocto-bsp \
  /home/jordanimejia/yocto/poky/build/meta-openembedded/meta-oe \
  /home/jordanimejia/yocto/poky/build/meta-openembedded/meta-python \
  /home/jordanimejia/yocto/poky/build/meta-openembedded/meta-multimedia \
  /home/jordanimejia/yocto/poky/build/meta-openembedded/meta-networking \
  /home/jordanimejia/yocto/poky/build/meta-raspberrypi \
  /home/jordanimejia/yocto/poky/build/meta-tensorflow-lite \
  /home/jordanimejia/yocto/poky/build/meta-java \
  /home/jordanimejia/yocto/poky/build/meta-sources \
  /home/jordanimejia/yocto/poky/build/meta-openembedded/meta-gnome \
  /home/jordanimejia/yocto/poky/build/meta-openembedded/meta-xfce \
  "
```

## meta-sources/conf/layer.conf
```bitbake
# We have a conf and classes directory, add to BBPATH
BBPATH .= ":${LAYERDIR}"

# We have recipes-* directories, add to BBFILES
BBFILES += "${LAYERDIR}/recipes-*/*/*.bb \
            ${LAYERDIR}/recipes-*/*/*.bbappend"

BBFILE_COLLECTIONS += "meta-sources"
BBFILE_PATTERN_meta-sources = "^${LAYERDIR}/"
BBFILE_PRIORITY_meta-sources = "6"

LAYERDEPENDS_meta-sources = "core"
LAYERSERIES_COMPAT_meta-sources = "kirkstone langdale"
```
